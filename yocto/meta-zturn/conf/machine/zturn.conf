## yocto/meta-zturn/conf/machine/zturn.conf
```bitbake
#@TYPE: Machine
#@NAME: zturn
#@DESCRIPTION: Machine support for MYIR Z-turn

PREFERRED_PROVIDER_virtual/kernel ?= "linux-xlnx"
PREFERRED_VERSION_linux-xlnx ?= "4.14%"
PREFERRED_PROVIDER_virtual/dtb ?= "device-tree"

#meta-xilinx
require conf/machine/include/tune-zynq.inc
require conf/machine/include/machine-xilinx-default.inc
require conf/machine/include/machine-xilinx-board.inc

#meta-xilinx-tools
# TODO(implr) lol wut
#require conf/machine/include/machine-xilinx-zynq.inc
#FIXME: needed for meta-xilinx-tools for now
KMACHINE_zynq = "zynq"

PREFERRED_PROVIDER_virtual/boot-bin = "xilinx-bootbin"

MACHINE_FEATURES = "ext2 vfat usbhost usbgadget screen serial"

UBOOT_MACHINE = "zynq_z_turn_config"

SERIAL_CONSOLE = "115200 ttyPS0"

MACHINE_ESSENTIAL_EXTRA_RDEPENDS += "device-tree"
MACHINE_DEVICETREE := " \
    zturn/devicetree.dts \
    "
MACHINE_ESSENTIAL_EXTRA_RRECOMMENDS += "\
    kernel-modules \
    ps7-init-extraction \
    "

IMAGE_BOOT_FILES += "boot.bin ${MACHINE}.dtb"
```

## yocto/scripts/conf/bblayers.conf
```bitbake
# POKY_BBLAYERS_CONF_VERSION is increased each time build/conf/bblayers.conf
# changes incompatibly
POKY_BBLAYERS_CONF_VERSION = "2"

BBPATH = "${TOPDIR}"
BSPDIR := "${@os.path.abspath(os.path.dirname(d.getVar('FILE', True)) + '/../..')}"

BBFILES ?= ""

BBLAYERS ?= " \
  ${BSPDIR}/poky/meta \
  ${BSPDIR}/poky/meta-poky \
  ${BSPDIR}/poky/meta-yocto-bsp \
  \
  ${BSPDIR}/meta-openembedded/meta-oe \
  ${BSPDIR}/meta-openembedded/meta-multimedia \
  ${BSPDIR}/meta-openembedded/meta-python \
  \
  ${BSPDIR}/meta-xilinx/meta-xilinx-bsp \
  ${BSPDIR}/meta-xilinx-tools \
  \
  ${BSPDIR}/meta-zturn \
  "
```
